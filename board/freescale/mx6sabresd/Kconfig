## board/freescale/mx6sabresd/Kconfig
```kconfig
if TARGET_MX6SABRESD

config SYS_BOARD
	default "mx6sabresd"

config SYS_VENDOR
	default "freescale"

config SYS_CONFIG_NAME
	default "mx6sabresd"

config TEE_RAM_SIZE
	hex "Size of TEE RAM"
	default "0x2000000"

endif
```
